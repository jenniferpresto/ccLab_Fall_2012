/*
 *********************************************************
 * Jennifer Presto                                       *
 * CCLab Homework                                        *
 * October 16, 2012                                      *
 *                                                       *
 * Assignment is to create an animal.                    *
 * Ultimate goal:                                        *
 * When animal is put in the dark, LEDs fade             *
 * and it starts to snore.                               *
 *                                                       *
 * Audio code adapted from High-Low Tech Group at MIT    *
 * Media Lab.                                            *
 *                                                       *
 * Library and source code can be found here:            *
 * http://hlt.media.mit.edu/?p=1963                      *
 *********************************************************
 */

// this version includes snoring sound
// Note: LEDs attached to pin 5.
// Because of sound function, PWM breaks in pins 3, 9, 10, 11,
// and those pins become digital only.
// LEDs therefore attached to pin #5 so fading works.
// Changed threshold here from 500 to 700
// (needed 900 threshold when powering from Vin pin and 9v battery).

// This version also adds blinkAwake function.


#include <PCM.h>


const int sensorPin = A0; //light sensor
const int ledPin = 5; // pin for LED; must be PWM pin
const int speakerPin = 11;
int sensorValue = 0; //variable to store value from light sensor
int threshold = 700;
boolean awake = true;
const unsigned char sample[] PROGMEM = { //snoring sound
  126, 126, 127, 127, 128, 128, 128, 127, 127, 126, 127, 127,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 128, 
};


void setup(){
  pinMode(ledPin, OUTPUT);
  pinMode(sensorPin, INPUT);
  pinMode(speakerPin, OUTPUT);
  Serial.begin(9600);
  threshold;
}

void loop(){
  sensorValue = analogRead(sensorPin);
  Serial.println(sensorValue);
  Serial.println(awake);
  
  if (sensorValue<threshold && awake){ //first falling asleep
    fadeLed();
    awake = false;
  }

  if (sensorValue<threshold && !awake){ //while asleep, snore
    analogWrite(ledPin, 0);
    startPlayback(sample, sizeof(sample));
    Serial.println(sensorValue);
    delay(3250);
  }

  if(sensorValue>=threshold && !awake){ // wake up by blinking
    blinkAwake();
    awake = true;  
  }

  if (sensorValue>=threshold && awake){ // stay awake
    analogWrite(ledPin, 255);
  }
}

//function to fade the LED to sleep

void fadeLed(){
  for (int brightness = 255; brightness>0; brightness--){
    analogWrite(ledPin, brightness);
    delay(20);
  }
  analogWrite(ledPin,0);
  delay(750);
}

void blinkAwake(){
  analogWrite(ledPin, 255);
  delay(500);
  analogWrite(ledPin, 0);
  delay(200);
  analogWrite(ledPin, 255);
  delay(300);
  analogWrite(ledPin, 0);
  delay(750);
}

